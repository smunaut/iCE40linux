## buildroot/configs/ice40linux_vexriscv_defconfig
```kconfig
# Target options
BR2_riscv=y
BR2_RISCV_32=y

# Instruction Set Extensions
BR2_riscv_custom=y
BR2_RISCV_ISA_CUSTOM_RVM=n
BR2_RISCV_ISA_CUSTOM_RVA=y
BR2_RISCV_ISA_CUSTOM_RVC=n
#BR2_RISCV_ISA_CUSTOM_RVF=y  # Uncomment to enable FPU
#BR2_RISCV_ISA_CUSTOM_RVD=y  # Uncomment to enable FPU
BR2_RISCV_ABI_ILP32=y

# GCC
BR2_GCC_VERSION_10_X=y

# System
BR2_TARGET_GENERIC_GETTY=y
BR2_TARGET_GENERIC_GETTY_PORT="console"

# Filesystem
BR2_TARGET_ROOTFS_CPIO=y

# Kernel
BR2_LINUX_KERNEL=y
BR2_LINUX_KERNEL_CUSTOM_GIT=y
BR2_LINUX_KERNEL_CUSTOM_REPO_URL="git://github.com/smunaut/iCE40linux-kernel.git"
BR2_LINUX_KERNEL_CUSTOM_REPO_VERSION="5f5c810dfa05a0dc45cb6c11ca1468d32d019de0"
BR2_LINUX_KERNEL_USE_CUSTOM_CONFIG=y
BR2_LINUX_KERNEL_CUSTOM_CONFIG_FILE="$(BR2_EXTERNAL_ICE40LINUX_VEXRISCV_PATH)/board/ice40linux_vexriscv/linux.config"
BR2_LINUX_KERNEL_IMAGE=y

BR2_PACKAGE_HOST_LINUX_HEADERS_CUSTOM_5_12=y

# Target
BR2_TARGET_GENERIC_HOSTNAME="ice40"
BR2_TARGET_GENERIC_ISSUE="Welcome to iCE40linux"
BR2_TARGET_GENERIC_REMOUNT_ROOTFS_RW=n

# Rootfs customisation
BR2_ROOTFS_OVERLAY="$(BR2_EXTERNAL_ICE40LINUX_VEXRISCV_PATH)/board/ice40linux_vexriscv/rootfs_overlay"

# Games
BR2_PACKAGE_ASCII_INVADERS=y
BR2_PACKAGE_XORCURSES=y

# Micropython
BR2_PACKAGE_MICROPYTHON=y
BR2_PACKAGE_MICROPYTHON_LIB=y

# No need for random stuff slowing boot
BR2_PACKAGE_URANDOM_SCRIPTS=n

# Extra packages
#BR2_PACKAGE_DHRYSTONE=y
#BR2_PACKAGE_MICROPYTHON=y
#BR2_PACKAGE_SPIDEV_TEST=y
#BR2_PACKAGE_MTD=y
#BR2_PACKAGE_MTD_JFFS_UTILS=y

# Crypto
#BR2_PACKAGE_LIBATOMIC_OPS_ARCH_SUPPORTS=y
#BR2_PACKAGE_LIBATOMIC_OPS=y
#BR2_PACKAGE_OPENSSL=y
#BR2_PACKAGE_LIBRESSL=y
#BR2_PACKAGE_LIBRESSL_BIN=y
#BR2_PACKAGE_HAVEGED=y

# Generate UBIFS Root
BR2_TARGET_ROOTFS_UBI=y
BR2_TARGET_ROOTFS_UBI_PEBSIZE=0x10000
BR2_TARGET_ROOTFS_UBI_SUBSIZE=0
BR2_TARGET_ROOTFS_UBI_OPTS=""
BR2_TARGET_ROOTFS_UBIFS=y
BR2_TARGET_ROOTFS_UBIFS_LEBSIZE=0xff80
BR2_TARGET_ROOTFS_UBIFS_MINIOSIZE=0x1
BR2_TARGET_ROOTFS_UBIFS_MAXLEBCNT=256
BR2_TARGET_ROOTFS_UBIFS_RT_LZO=y
BR2_TARGET_ROOTFS_UBIFS_NONE=y
BR2_TARGET_ROOTFS_UBIFS_OPTS=""
```
